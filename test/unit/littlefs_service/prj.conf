## CMakeLists.txt
```
# SPDX-License-Identifier: Apache-2.0

cmake_minimum_required(VERSION 3.20.0)

include(${CMAKE_CURRENT_LIST_DIR}/../../common/diagnostics.cmake)

find_package(Zephyr REQUIRED HINTS $ENV{ZEPHYR_BASE})
project(littlefs_service_test)

target_sources(app PRIVATE
  src/main.cpp
  ../../../platform/storage/filesystem/littlefs_service.cpp
)

target_include_directories(app PRIVATE
  ../../..
  ../../../../littlefs
)

# Host unit tests do not have an application devicetree partition. The value is
# only forwarded to the mocked filesystem API in this test binary.
target_compile_definitions(app PRIVATE
  WBR_CONTROL_STORAGE_PARTITION_ID=7
  CONFIG_FS_LITTLEFS_READ_SIZE=16
  CONFIG_FS_LITTLEFS_PROG_SIZE=16
  CONFIG_FS_LITTLEFS_CACHE_SIZE=64
  CONFIG_FS_LITTLEFS_LOOKAHEAD_SIZE=32
)
```

## prj.conf
```kconfig
CONFIG_ZTEST=y
CONFIG_CPP=y
CONFIG_LOG=y
```

## src/main.cpp
```c
/* SPDX-License-Identifier: Apache-2.0 */

#include <errno.h>

#include <zephyr/fff.h>
#include <zephyr/fs/fs.h>
#include <zephyr/storage/flash_map.h>
#include <zephyr/ztest.h>

#include <platform/storage/filesystem/littlefs_service.h>

DEFINE_FFF_GLOBALS;

FAKE_VALUE_FUNC(int, fs_mount, struct fs_mount_t *);
FAKE_VALUE_FUNC(int, fs_mkfs, int, uintptr_t, void *, int);
FAKE_VALUE_FUNC(int, flash_area_open, uint8_t, const struct flash_area **);
FAKE_VOID_FUNC(flash_area_close, const struct flash_area *);
FAKE_VALUE_FUNC(int, flash_area_flatten, const struct flash_area *, off_t, size_t);
FAKE_VALUE_FUNC(int, flash_area_erase, const struct flash_area *, off_t, size_t);
FAKE_VALUE_FUNC(int, flash_area_write, const struct flash_area *, off_t, const void *, size_t);
FAKE_VALUE_FUNC(int, flash_area_read, const struct flash_area *, off_t, void *, size_t);

ZTEST(littlefs_service, formats_and_remounts_after_initial_mount_failure)
{
	int mount_results[] = {-ENODEV, 0};
	SET_RETURN_SEQ(fs_mount, mount_results, ARRAY_SIZE(mount_results));
	fs_mkfs_fake.return_val = 0;

	zassert_ok(platform::InitializeLittlefs());
	zassert_true(platform::IsLittlefsReady());
	zassert_equal(fs_mount_fake.call_count, 2U);
	zassert_equal(fs_mkfs_fake.call_count, 1U);
	zassert_equal(fs_mkfs_fake.arg0_val, FS_LITTLEFS);
	zassert_equal(fs_mkfs_fake.arg1_val, 7U);
	zassert_equal(fff.call_history_idx, 3U);
	zassert_equal_ptr(fff.call_history[0], fs_mount);
	zassert_equal_ptr(fff.call_history[1], fs_mkfs);
	zassert_equal_ptr(fff.call_history[2], fs_mount);

	/* Once mounted, subsequent callers must not touch the filesystem again. */
	zassert_ok(platform::InitializeLittlefs());
	zassert_equal(fs_mount_fake.call_count, 2U);
	zassert_equal(fs_mkfs_fake.call_count, 1U);
	zassert_str_equal(platform::LittlefsMountPoint(), "/lfs");
}

ZTEST_SUITE(littlefs_service, nullptr, nullptr, nullptr, nullptr, nullptr);
```
