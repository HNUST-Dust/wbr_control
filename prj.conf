## CMakeLists.txt
```
# SPDX-License-Identifier: Apache-2.0

cmake_minimum_required(VERSION 3.20.0)

# T2: hpm_support is a project, not manifest repo.
# Compute paths relative to wbr_control location (workspace root).
set(HPM_ZEPHYR_DIR ${CMAKE_CURRENT_SOURCE_DIR}/../hpm_support)
set(HPM_SDK_DIR ${CMAKE_CURRENT_SOURCE_DIR}/../../sdk_env/hpm_sdk)
set(HPM_ENV_DIR ${CMAKE_CURRENT_SOURCE_DIR}/../../sdk_env)
# Eigen：纯头文件线性代数库，位于 workspace 根（../eigen）。
set(EIGEN_DIR ${CMAKE_CURRENT_SOURCE_DIR}/../eigen)
# Sophus：纯头文件李群库，作为 west project 位于 workspace 根（../sophus）。
set(SOPHUS_DIR ${CMAKE_CURRENT_SOURCE_DIR}/../sophus)
set(FATFS_DIR ${CMAKE_CURRENT_SOURCE_DIR}/../fatfs)

set(CMAKE_EXPORT_COMPILE_COMMANDS ON)

list(APPEND BOARD_ROOT ${HPM_ZEPHYR_DIR})

find_package(Zephyr REQUIRED HINTS $ENV{ZEPHYR_BASE})
project(wbr_control)

# Generate validated constexpr parameter headers from value/schema YAML pairs.
# Targets throughout the repository use this one helper and one Python tool.
function(wbr_generate_params target name values schema cpp_namespace)
  set(generated_dir ${CMAKE_BINARY_DIR}/generated/params)
  set(generated_header ${generated_dir}/${name}_params_generated.h)
  set(generator ${PROJECT_SOURCE_DIR}/tools/generate_params.py)

  add_custom_command(
    OUTPUT ${generated_header}
    COMMAND ${PYTHON_EXECUTABLE} ${generator}
      --input ${values}
      --schema ${schema}
      --namespace ${cpp_namespace}
      --output ${generated_header}
    DEPENDS ${values} ${schema} ${generator}
    COMMENT "Generating validated ${name} parameters"
    VERBATIM
  )
  add_custom_target(wbr_${name}_params DEPENDS ${generated_header})
  add_dependencies(${target} wbr_${name}_params)
  target_include_directories(${target} PRIVATE ${generated_dir})
endfunction()

# Validate the resolved configuration after Kconfig so UART0 remains reserved
# for the binary oscilloscope stream.
if(NOT CONFIG_UART_ASYNC_API)
  message(FATAL_ERROR
    "The UART0 oscilloscope output requires CONFIG_UART_ASYNC_API=y")
endif()

target_include_directories(app PRIVATE
  ${PROJECT_SOURCE_DIR}
  ${PROJECT_SOURCE_DIR}/src
)
target_include_directories(app SYSTEM PRIVATE ${EIGEN_DIR})
target_include_directories(app SYSTEM PRIVATE ${FATFS_DIR}/include)
if(EXISTS ${SOPHUS_DIR}/sophus/so3.hpp)
  target_include_directories(app SYSTEM PRIVATE ${SOPHUS_DIR})
endif()

if(CONFIG_CHERRYUSB)
  set(CHERRYUSB_CONFIG_DIR ${HPM_ZEPHYR_DIR}/samples/cherryusb/config)
  zephyr_include_directories(${CHERRYUSB_CONFIG_DIR})
  zephyr_include_directories(${HPM_SDK_DIR}/components/usb/device)
endif()

target_sources(app PRIVATE
  src/main.cpp
)

# 模块仅由 main 线程顺序构造，关闭局部静态对象的线程安全初始化守卫。
target_compile_options(app PRIVATE
  -fno-threadsafe-statics
)

add_subdirectory(msg)
add_subdirectory(src/protocols)
add_subdirectory(src/scheduling)
add_subdirectory(src/modules)
add_subdirectory(platform)
add_subdirectory(debug)

# 应用入口只直接依赖模块、通道和平台；协议由模块目标自行声明。
target_link_libraries(app PRIVATE
  wbr_msg
  wbr_modules
  wbr_platform
)

if(TARGET wbr_debug)
  target_link_libraries(app PRIVATE wbr_debug)
endif()
```

## Kconfig
```
# SPDX-License-Identifier: Apache-2.0

source "Kconfig.zephyr"

menu "wbr_control application options"

config WBR_CONTROL_RTT_DIAGNOSTICS
	bool "Enable shell, logging and printk diagnostics over SEGGER RTT"
	depends on HAS_SEGGER_RTT
	select USE_SEGGER_RTT
	select SHELL
	select SHELL_BACKEND_RTT
	select SHELL_LOG_BACKEND
	select LOG
	select LOG_PRINTK
	select PRINTK
	help
	  Route the interactive shell, LOG_* messages and printk() through the
	  RTT shell backend. This path is independent of UART0, so it can remain
	  enabled while UART0 carries the binary VOFA oscilloscope stream.

config WBR_CONTROL_MODULE_REMOTE_INPUT
	bool "Enable remote_input module"
	default y
	help
	  Enable registering and starting the remote_input module.

config WBR_CONTROL_MODULE_CHASSIS
	bool "Enable chassis module"
	default y
	help
	  Register and start the 1 kHz independent-leg chassis controller.

config WBR_CONTROL_MODULE_REFEREE
	bool "Enable referee module"
	default n
	help
	  Enable registering and starting the referee module.

config WBR_CONTROL_MODULE_OSCILLOSCOPE
	bool
	default y
	help
	  UART0 is permanently reserved for the VOFA oscilloscope binary stream.
	  Diagnostics use SEGGER RTT instead of UART0.

config WBR_CONTROL_OSCILLOSCOPE_UART_BAUDRATE
	int "VOFA oscilloscope UART baudrate"
	default 921600
	depends on WBR_CONTROL_MODULE_OSCILLOSCOPE
	help
	  UART0 baudrate used by the VOFA+ oscilloscope output.

config WBR_CONTROL_OSCILLOSCOPE_PERIOD_MS
	int "VOFA oscilloscope output period in milliseconds"
	default 10
	depends on WBR_CONTROL_MODULE_OSCILLOSCOPE
	help
	  Output period for the VOFA+ oscilloscope module. A value of 10 ms
	  gives 100 Hz output.

config WBR_CONTROL_MODULE_HI91_IMU
	bool "Enable HI91 IMU module"
	default n
	depends on SERIAL && UART_ASYNC_API
	help
	  Enable the HI91 external IMU module on UART2. The module parses HI91
	  binary frames and publishes the latest IMU sample to channels.

config WBR_CONTROL_MODULE_AHRS
	bool "Enable onboard AHRS module"
	default n
	depends on SPI && SPI_ASYNC && SPI_HPM_SPI_DMA && GPIO
	help
	  Enable the board AHRS. Its single thread owns the onboard ICM42688P-HXY,
	  performs asynchronous SPI HDMA reads, calibrates gyro bias, and updates
	  the quaternion EKF estimator from each completed sample.
	  Devicetree aliases onboard-imu-cs and onboard-imu-drdy must describe the
	  custom PCB connections.

config WBR_CONTROL_ONBOARD_IMU_SPI_FREQUENCY_HZ
	int "Onboard ICM42688P SPI frequency"
	default 8000000
	range 100000 24000000
	depends on WBR_CONTROL_MODULE_AHRS
	help
	  SPI2 bus frequency used for register access and 12-byte six-axis
	  burst reads. Start conservatively if PCB signal integrity is unknown.

config WBR_CONTROL_ONBOARD_IMU_CALIBRATION_SAMPLES
	int "Stationary gyro calibration sample count"
	default 1000
	range 100 5000
	depends on WBR_CONTROL_MODULE_AHRS
	help
	  Number of consecutive stationary 1 kHz AHRS samples used to estimate the
	  startup gyro bias. The proven BMI088 implementation used a one-second,
	  1000-sample average. The counter resets if motion is detected, so the
	  robot must remain still until calibration completes.

config WBR_CONTROL_ONBOARD_IMU_BODY_MAP_CONFIRMED
	bool "Onboard IMU sensor-to-body map verified on hardware"
	default n
	depends on WBR_CONTROL_MODULE_AHRS
	help
	  Enable only after physically rotating the assembled robot around each
	  body axis and verifying the configured axis order and signs. The chassis
	  cannot select the onboard IMU until this acknowledgement is enabled.

choice WBR_CONTROL_CHASSIS_IMU_SOURCE
	prompt "Chassis attitude source"
	default WBR_CONTROL_CHASSIS_IMU_HI91
	depends on WBR_CONTROL_MODULE_CHASSIS

config WBR_CONTROL_CHASSIS_IMU_HI91
	bool "HI91 external IMU"
	depends on WBR_CONTROL_MODULE_HI91_IMU

config WBR_CONTROL_CHASSIS_IMU_ONBOARD_EKF
	bool "Onboard IMU quaternion EKF attitude"
	depends on WBR_CONTROL_MODULE_AHRS && WBR_CONTROL_ONBOARD_IMU_BODY_MAP_CONFIRMED

endchoice

config WBR_CONTROL_HI91_IMU_UART_BAUDRATE
	int "HI91 IMU UART baudrate"
	default 921600
	depends on WBR_CONTROL_MODULE_HI91_IMU
	help
	  UART2 baudrate used by the HI91 external IMU module.

config WBR_CONTROL_HI91_IMU_STRICT_CRC
	bool "Reject HI91 frames with CRC mismatch"
	default n
	depends on WBR_CONTROL_MODULE_HI91_IMU
	help
	  Reject frames that do not match the built-in CRC16 check. Keep this
	  disabled until the exact CRC variant is confirmed from the device
	  manual or captured frames.

config WBR_CONTROL_MODULE_SYS_STATE
	bool "Enable status indicator module"
	default n
	depends on GPIO || PWM
	help
	  Enable registering and starting the system status indicator module.
	  The module supports RGB breathing LED and optional PWM buzzer output.

config WBR_CONTROL_SHELL_MAVLINK_CONTROL
	bool "Enable MAVLink shell control command"
	default n
	depends on SHELL
	help
	  Enable `mavlink on/off/status` shell command. When enabled,
	  MAVLink bytes are received on the same shell UART by using shell bypass.

config WBR_CONTROL_RUNTIME_INIT_CAN
	bool "Initialize CAN dispatch in bootstrap"
	default y
	depends on CAN
	help
	  Enable CAN dispatch initialization during runtime bootstrap.

config WBR_CONTROL_RUNTIME_INIT_USB
	bool "Initialize USB session in bootstrap"
	default n
	depends on CHERRYUSB_DEVICE
	help
	  Enable CherryUSB Vendor Interrupt session initialization during runtime bootstrap.

config WBR_CONTROL_PC_LINK
	bool "Enable PC link protocol over USB"
	default y
	depends on WBR_CONTROL_RUNTIME_INIT_USB
	help
	  Enable the pc_link session worker inside usb_session. The worker
	  assembles the auto-aim telemetry packet from the gimbal/booster/imu/
	  remote_input channels at a fixed rate and parses auto-aim commands
	  received from the PC over USB Vendor Interrupt endpoints.

config WBR_CONTROL_PC_LINK_PERIOD_MS
	int "PC link send period in milliseconds"
	default 1
	depends on WBR_CONTROL_PC_LINK
	help
	  Period at which the pc_link worker publishes the auto-aim state frame.

config WBR_CONTROL_PC_LINK_COMMAND_TIMEOUT_MS
	int "PC link command timeout in milliseconds"
	range 10 5000
	default 100
	depends on WBR_CONTROL_PC_LINK
	help
	  Publish an idle command when no valid PC control frame has been received
	  within this interval. USB reset and disconnect also request an idle command.

config WBR_CONTROL_RUNTIME_INIT_LITTLEFS
	bool "Initialize LittleFS in bootstrap"
	default n
	depends on FILE_SYSTEM_LITTLEFS
	help
	  Enable LittleFS initialization during runtime bootstrap.

endmenu
```

## west.yml
```
# T2: Star topology, application is the manifest repository.
# wbr_control is the manifest repository (application-as-manifest).
#
# West workspace configuration (.west/config):
#   [manifest]
#   path = wbr_control
#   file = west.yml

########################################
##  zephyr                    v3.7.0  ##
##  hpm_sdk                   v1.11.0 ##
########################################
manifest:
  version: "1.0"

  remotes:
    - name: github
      url-base: https://github.com/hpmicro
    - name: cherry-embedded
      url-base: https://github.com/cherry-embedded/
    - name: cherryusb-fork
      url-base: https://github.com/NoneOfEver
    - name: upstream
      url-base: https://github.com/zephyrproject-rtos
    - name: dust-mavlink
      url-base: https://github.com/NoneOfEver
    - name: dust-hpm
      url-base: https://github.com/NoneOfEver
    # Eigen 官方仓库在 GitLab（GitHub 的 eigenteam/eigen-git-mirror 已停更在 3.3.7）。
    - name: eigen
      url-base: https://gitlab.com
    - name: sophus
      url-base: https://github.com/strasdat
    - name: tinympc
      url-base: https://github.com/NoneOfEver

  defaults:
    remote: github

  projects:
    # Zephyr RTOS. Third-party projects are declared explicitly below so every
    # repository can live directly under the workspace root.
    - name: zephyr
      remote: github
      repo-path: zephyr
      revision: zsg_v0.7.0
      west-commands: scripts/west-commands.yml

    # ELM FatFs implementation required by Zephyr's FAT filesystem layer.
    - name: fatfs
      remote: upstream
      repo-path: fatfs
      path: fatfs
      revision: 427159bf95ea49b7680facffaa29ad506b42709b

    # HPMicro SDK (manifest repo with boards, drivers, soc, dts)
    - name: hpm_support
      remote: dust-hpm
      repo-path: hpm_support
      path: hpm_support
      # Internally maintained dependency: always consume the latest main branch.
      revision: main
      west-commands: scripts/west-commands.yml

    # SEGGER RTT transport used by the non-UART shell/logging diagnostics.
    # Keep this revision aligned with the Zephyr 3.7 manifest.
    - name: segger
      remote: upstream
      repo-path: segger
      path: segger
      revision: b011c45b585e097d95d9cf93edf4f2e01588d3cd

    - name: CherryUSB
      remote: cherryusb-fork
      repo-path: CherryUSB
      path: cherry_usb
      revision: 50c7e9085801e24d2d0991d0c4c1609fdbcfb90a

    # Mavlink generated headers
    - name: dust_mavlink
      remote: dust-mavlink
      repo-path: dust_mavlink
      path: mavlink
      revision: main

    # Eigen：纯头文件线性代数库（MPL-2.0），用于状态估计 / MPC / 坐标系变换。
    # 3.4.0 为当前最新稳定版，对应 commit 3147391d946bb4b6c68edd901f2add6ac1f31f8c。
    - name: eigen
      remote: eigen
      repo-path: libeigen/eigen
      path: eigen
      revision: 3.4.0

    # Sophus：基于 Eigen 的纯头文件李群库。固件仅使用固定尺寸 SO3f，禁止在
    # 1 kHz 实时路径中使用字符串 frame、动态缓存或失败格式化路径。
    - name: sophus
      remote: sophus
      repo-path: Sophus
      path: sophus
      revision: d0b7315a0d90fc6143defa54596a3a95d9fa10ec

    # TinyMPC：面向资源受限 MCU 的 MPC 求解器。目前只供独立 host test
    # 使用，尚未链接到正式 Zephyr 固件目标。
    - name: TinyMPC
      remote: tinympc
      repo-path: TinyMPC
      path: tiny_mpc
      revision: 023f36bd5b27267e1a96ed47a774d120b5707f13

  self:
    path: wbr_control
    west-commands: scripts/west-commands.yml
```

## prj.conf
```kconfig
CONFIG_UART_CONSOLE=n
CONFIG_LOG_BACKEND_UART=n
CONFIG_SERIAL=y
CONFIG_SPI=y
CONFIG_SPI_HPMICRO=y
CONFIG_SPI_ASYNC=y
CONFIG_SPI_HPM_SPI_DMA=y
CONFIG_SPI_HPM_SPI_INTERRUPT=n
CONFIG_BOOT_BANNER=n
CONFIG_PWM=y
CONFIG_STDOUT_CONSOLE=n
CONFIG_CPP=y
CONFIG_STD_CPP17=y
CONFIG_REQUIRES_FULL_LIBCPP=y
CONFIG_HPM67_DOUBLE_PRECISION_FPU=y
CONFIG_FPU=y
CONFIG_FPU_SHARING=y
CONFIG_ZBUS=y
CONFIG_RING_BUFFER=y
CONFIG_LOG=y
CONFIG_LOG_MODE_OVERFLOW=y
CONFIG_LOG_BLOCK_IN_THREAD=n
CONFIG_UART_ASYNC_API=y
CONFIG_UART_INTERRUPT_DRIVEN=y
CONFIG_CAN=y
CONFIG_WBR_CONTROL_RTT_DIAGNOSTICS=y
CONFIG_SEGGER_RTT_BUFFER_SIZE_UP=16384
CONFIG_SHELL_THREAD_PRIORITY_OVERRIDE=n
# CONFIG_SHELL_THREAD_PRIORITY=7
CONFIG_TIMESLICING=y
CONFIG_TIMESLICE_SIZE=1
CONFIG_THREAD_RUNTIME_STATS=y
CONFIG_THREAD_RUNTIME_STATS_USE_TIMING_FUNCTIONS=y
CONFIG_SCHED_THREAD_USAGE_ANALYSIS=y
CONFIG_INIT_STACKS=y
CONFIG_THREAD_ANALYZER=n
CONFIG_THREAD_ANALYZER_USE_PRINTK=n
CONFIG_FLASH=y
CONFIG_FLASH_MAP=y
CONFIG_DEBUG_COREDUMP=y
CONFIG_DEBUG_COREDUMP_BACKEND_LOGGING=n
CONFIG_DEBUG_COREDUMP_BACKEND_FLASH_PARTITION=y
CONFIG_DEBUG_COREDUMP_MEMORY_DUMP_MIN=y
CONFIG_DEBUG_COREDUMP_SHELL=y

# FAT32 TF-card logging. The card is never formatted automatically.
CONFIG_DISK_ACCESS=y
CONFIG_DISK_DRIVER_SDMMC=y
CONFIG_SDMMC_SUBSYS=y
CONFIG_SDMMC_VOLUME_NAME="SD"
CONFIG_FILE_SYSTEM=y
CONFIG_FILE_SYSTEM_SHELL=y
CONFIG_FAT_FILESYSTEM_ELM=y
CONFIG_FS_FATFS_EXFAT=y
CONFIG_FS_FATFS_MOUNT_MKFS=n
CONFIG_FS_FATFS_MKFS=n
CONFIG_WBR_CONTROL_MODULE_SDLOG=y

CONFIG_CHERRYUSB=y
CONFIG_CHERRYUSB_DEVICE=y
CONFIG_CHERRYUSB_DEVICE_SPEED_HS=y
CONFIG_CHERRYUSB_DEVICE_HPM=y

# 应用功能模块全部启用；仅文件系统和 MAVLink shell 保持关闭。
CONFIG_WBR_CONTROL_RUNTIME_INIT_CAN=y
CONFIG_WBR_CONTROL_RUNTIME_INIT_USB=y
CONFIG_WBR_CONTROL_PC_LINK=y
CONFIG_WBR_CONTROL_PC_LINK_PERIOD_MS=1
CONFIG_WBR_CONTROL_PC_LINK_COMMAND_TIMEOUT_MS=100
CONFIG_WBR_CONTROL_SHELL_MAVLINK_CONTROL=n

CONFIG_WBR_CONTROL_MODULE_REMOTE_INPUT=y
CONFIG_WBR_CONTROL_MODULE_CHASSIS=y
CONFIG_WBR_CONTROL_MODULE_REFEREE=y
CONFIG_WBR_CONTROL_MODULE_HI91_IMU=y
CONFIG_WBR_CONTROL_CHASSIS_IMU_ONBOARD_EKF=y
CONFIG_WBR_CONTROL_MODULE_AHRS=n
CONFIG_WBR_CONTROL_MODULE_SYS_STATE=y
CONFIG_WBR_CONTROL_ONBOARD_IMU_CALIBRATION_SAMPLES=1000
CONFIG_WBR_CONTROL_ONBOARD_IMU_BODY_MAP_CONFIRMED=n
CONFIG_WBR_CONTROL_CHASSIS_IMU_HI91=y
```

## app.overlay
```dts
&cherryusb_usb0 {
	status = "okay";
};
```

## src/main.cpp
```c
/*
 * SPDX-License-Identifier: Apache-2.0
 */

/**
* @file src/main.cpp
 * @ingroup wbr_control
 * @brief 实现应用或测试程序的入口与初始化流程。
 * @details 主入口按依赖顺序初始化平台服务和应用模块。任一必需模块启动失败都会保留诊断信息，避免在输入或执行器未就绪时进入闭环控制。
 */

#include <errno.h>

#include <zephyr/kernel.h>
#include <zephyr/logging/log.h>
#include <zephyr/sys/printk.h>
#include <zephyr/sys/util.h>

#include "modules/chassis/chassis_module.h"
#include "modules/imu/hi91_imu_module.h"
#include "modules/ahrs/ahrs.h"
#include "modules/oscilloscope/oscilloscope_module.h"
#include "modules/referee/referee_module.h"
#include "modules/remote_input/remote_input_module.h"
#include "modules/sys_state/sys_state_module.h"
#include "modules/sdlog/sdlog_module.h"
#include <msg/system_status_message.hpp>
#include <platform/board/board_identity.h>

LOG_MODULE_REGISTER(app_main, LOG_LEVEL_INF);

#if defined(CONFIG_WBR_CONTROL_RUNTIME_INIT_CAN) && CONFIG_WBR_CONTROL_RUNTIME_INIT_CAN
#include <platform/drivers/communication/can_dispatch.h>
#endif

#if defined(CONFIG_WBR_CONTROL_RUNTIME_INIT_USB) && CONFIG_WBR_CONTROL_RUNTIME_INIT_USB
#include <platform/drivers/communication/usb_session.h>
#endif

namespace
{

void PublishSystemStatus(msg::BootPhase state, uint32_t module_count)
{
	const msg::SystemStatusMessage status = {
		state,
		module_count,
	};
	(void)msg::system_status.Publish(status);
}

} // namespace

/**
 * @brief 按依赖顺序启动平台服务和应用模块。
 * @return 初始化成功后线程永久休眠；启动失败时返回对应负 errno 错误码。
 */
int main(void)
{
	if (IS_ENABLED(CONFIG_WBR_CONTROL_RTT_DIAGNOSTICS)) {
		printk("[printk] wbr_control RTT diagnostics ready\n");
	}
	LOG_INF("wbr_control started on %s", board_identity_name());
	PublishSystemStatus(msg::kBooting, 0U);

	int rc = 0;

#if defined(CONFIG_WBR_CONTROL_RUNTIME_INIT_CAN) && CONFIG_WBR_CONTROL_RUNTIME_INIT_CAN
	if (IS_ENABLED(CONFIG_WBR_CONTROL_RUNTIME_INIT_CAN)) {
		rc = platform::InitializeCanDispatch();
		if (rc != 0) {
			if (rc == -ENODEV) {
				LOG_WRN("can_dispatch init skipped: no CAN device");
			} else {
				LOG_ERR("can_dispatch init failed: %d", rc);
				return rc;
			}
		}
	}
#endif

#if defined(CONFIG_WBR_CONTROL_RUNTIME_INIT_USB) && CONFIG_WBR_CONTROL_RUNTIME_INIT_USB
	if (IS_ENABLED(CONFIG_WBR_CONTROL_RUNTIME_INIT_USB)) {
		rc = platform::InitializeUsbSession();
		if (rc != 0) {
			if (rc == -ENODEV) {
				LOG_WRN("usb_session init skipped: no USB device");
			} else {
				LOG_ERR("usb_session init failed: %d", rc);
				return rc;
			}
		}
	}
#endif

	uint32_t module_count = 0U;

#if defined(CONFIG_WBR_CONTROL_MODULE_SYS_STATE) && CONFIG_WBR_CONTROL_MODULE_SYS_STATE
	{
		static modules::SysStateModule sys_state_module;
		rc = sys_state_module.Start();
		if (rc != 0) {
			LOG_ERR("module start failed: sys_state (%d)", rc);
			return rc;
		}
		++module_count;
	}
#endif
#if defined(CONFIG_WBR_CONTROL_MODULE_REMOTE_INPUT) && CONFIG_WBR_CONTROL_MODULE_REMOTE_INPUT
	{
		static modules::RemoteInputModule remote_input_module;
		rc = remote_input_module.Start();
		if (rc != 0) {
			LOG_ERR("module start failed: remote_input (%d)", rc);
			return rc;
		}
		++module_count;
	}
#endif
#if defined(CONFIG_WBR_CONTROL_MODULE_CHASSIS) && CONFIG_WBR_CONTROL_MODULE_CHASSIS
	{
		static modules::ChassisModule chassis_module;
		rc = chassis_module.Start();
		if (rc != 0) {
			LOG_ERR("module start failed: chassis (%d)", rc);
			return rc;
		}
		++module_count;
	}
#endif
#if defined(CONFIG_WBR_CONTROL_MODULE_REFEREE) && CONFIG_WBR_CONTROL_MODULE_REFEREE
	{
		static modules::RefereeModule referee_module;
		rc = referee_module.Start();
		if (rc != 0) {
			LOG_ERR("module start failed: referee (%d)", rc);
			return rc;
		}
		++module_count;
	}
#endif
	{
		static modules::OscilloscopeModule oscilloscope_module;
		rc = oscilloscope_module.Start();
		if (rc != 0) {
			LOG_ERR("module start failed: oscilloscope (%d)", rc);
			return rc;
		}
		++module_count;
	}
#if defined(CONFIG_WBR_CONTROL_MODULE_HI91_IMU) && CONFIG_WBR_CONTROL_MODULE_HI91_IMU
	{
		static modules::Hi91ImuModule hi91_imu_module;
		rc = hi91_imu_module.Start();
		if (rc != 0) {
			LOG_ERR("module start failed: hi91_imu (%d)", rc);
			return rc;
		}
		++module_count;
	}
#endif
#if defined(CONFIG_WBR_CONTROL_MODULE_AHRS) && CONFIG_WBR_CONTROL_MODULE_AHRS
	{
		static modules::Ahrs ahrs;
		rc = ahrs.Start();
		if (rc != 0) {
			LOG_ERR("module start failed: ahrs (%d)", rc);
			return rc;
		}
		++module_count;
	}
#endif
#if defined(CONFIG_WBR_CONTROL_MODULE_SDLOG) && CONFIG_WBR_CONTROL_MODULE_SDLOG
	{
		static modules::SdLogModule sdlog_module;
		rc = sdlog_module.Start();
		if (rc != 0) {
			LOG_WRN("module start skipped: sdlog (%d)", rc);
		} else {
			++module_count;
		}
	}
#endif
	PublishSystemStatus(msg::kRunning, module_count);

	/* 初始化结束后主线程不再承担周期任务，各模块由自己的线程运行。 */
	k_sleep(K_FOREVER);
	return 0;
}
```

## src/module_base.h
```c
/*
 * SPDX-License-Identifier: Apache-2.0
 */

/**
* @file src/module_base.h
 * @ingroup wbr_modules
 * @brief 定义应用功能模块的统一生命周期接口。
 * @details 模块遵循 `ModuleBase` 生命周期：`Start()` 只负责一次性资源初始化和线程创建，`RunLoop()` 持有周期状态。跨线程数据通过 msg 层交换。
 */

#pragma once

#include <errno.h>

#include <zephyr/kernel.h>

namespace modules
{

/*
 * 常驻线程模块的最小抽象基类。
 *
 * 基类定义模块统一的启动和运行接口，并消除线程对象、重复启动保护、线程创建
 * 和入口转发样板；不管理模块的初始化顺序、运行状态或退出流程。
 */
/** @brief 所有周期应用模块必须实现的生命周期基类。 */
class ModuleBase
{
public:
	virtual ~ModuleBase() = default;

	/**
	 * @brief 初始化模块资源并创建工作线程。
	 * @return 成功返回 0；初始化或线程创建失败返回负 errno 错误码。
	 */
	virtual int Start() = 0;
	/**
	 * @brief 执行模块线程的周期主循环。
	 */
	virtual void RunLoop() = 0;

protected:
	/**
	 * @brief 创建并启动绑定当前模块实例的 Zephyr 线程。
	 * @param[in,out] stack Zephyr 线程栈内存。
	 * @param stack_size 线程栈容量，单位为字节。
	 * @param priority Zephyr 抢占式线程优先级。
	 * @param[in] thread_name 线程诊断名称；字符串必须在创建调用期间有效。
	 * @return 成功返回 0，参数无效或底层操作失败时返回负 errno 错误码。
	 */
	int CreateThread(k_thread_stack_t *stack, size_t stack_size, int priority,
			 const char *thread_name)
	{
		if (started_) {
			return 0;
		}

		k_tid_t thread_id =
			k_thread_create(&thread_, stack, stack_size, ThreadEntry,
					this, nullptr, nullptr, priority, 0U, K_NO_WAIT);
		if (thread_id == nullptr) {
			return -ENOMEM;
		}

		(void)k_thread_name_set(thread_id, thread_name);
		started_ = true;
		return 0;
	}

	struct k_thread thread_; ///< Zephyr 工作线程控制块。
	bool started_ = false; ///< 防止模块被重复启动的生命周期标志。

private:
	/**
	 * @brief 将 Zephyr C 风格线程入口转发到模块实例。
	 * @param[in,out] instance 模块实例指针。
	 */
	static void ThreadEntry(void *instance, void *, void *)
	{
		static_cast<ModuleBase *>(instance)->RunLoop();
	}
};

} // namespace modules
```

## src/periodic_schedule.h
```c
/*
 * SPDX-License-Identifier: Apache-2.0
 */

/**
* @file src/periodic_schedule.h
 * @ingroup wbr_scheduling
 * @brief 提供基于 Zephyr 内核时钟的无漂移周期调度器。
 * @details 调度工具以 Zephyr 单调时钟为基准，使用绝对释放时刻避免执行时间抖动累积为长期周期漂移。
 */

#ifndef WBR_CONTROL_SCHEDULING_PERIODIC_SCHEDULE_H_
#define WBR_CONTROL_SCHEDULING_PERIODIC_SCHEDULE_H_

#include <cstdint>
#include <limits>

#include <zephyr/kernel.h>

namespace wbr_control::scheduling {

/*
 * Absolute periodic release with phase preservation.
 *
 * If the caller or scheduler falls behind, old releases are counted and
 * skipped. The caller executes at most once per invocation, preventing an
 * overloaded thread from running back-to-back to replay obsolete work.
 */
/** @brief 以绝对截止时间避免累计漂移的周期调度器。 */
class AbsolutePeriodicSchedule {
public:
	/**
	 * @brief 创建保持指定周期和初始相位的绝对时间调度器。
	 * @param period_ms 调度周期，单位为毫秒；零值按一个内核节拍处理。
	 * @param initial_phase_ms 相对系统周期边界的首次释放相位，单位为毫秒。
	 */
	AbsolutePeriodicSchedule(uint32_t period_ms, uint32_t initial_phase_ms)
		: period_ticks_(TicksFromMs(period_ms)),
		  initial_phase_ticks_(TicksFromMsAllowZero(initial_phase_ms))
	{
		/**
		 * @brief 清空内部状态并恢复到初始条件。
		 */
		Reset();
	}

	/**
	 * @brief 清空内部状态并恢复到初始条件。
	 */
	void Reset()
	{
		const int64_t now = k_uptime_ticks();
		const int64_t phase_ticks =
			initial_phase_ticks_ % period_ticks_;
		next_release_tick_ =
			now - (now % period_ticks_) + phase_ticks;
		if (next_release_tick_ < now) {
			next_release_tick_ += period_ticks_;
		}
		total_missed_releases_ = 0U;
	}

	/**
	 * @brief 等待下一绝对释放时刻并更新丢周期统计。
	 * @return 本次等待期间错过的释放次数。
	 */
	uint32_t WaitForNextRelease()
	{
		uint64_t missed = 0U;
		int64_t now = k_uptime_ticks();

		if (now > next_release_tick_) {
			const uint64_t late_ticks =
				static_cast<uint64_t>(now - next_release_tick_);
			const uint64_t skipped =
				(late_ticks + static_cast<uint64_t>(period_ticks_) - 1U) /
				static_cast<uint64_t>(period_ticks_);
			next_release_tick_ +=
				static_cast<int64_t>(skipped) * period_ticks_;
			missed += skipped;
		}

		k_sleep(K_TIMEOUT_ABS_TICKS(next_release_tick_));

		/*
		 * A higher-priority task or ISR may delay the wake-up past one or
		 * more later releases. Treat the wake-up as the newest release and
		 * skip the obsolete ones before calculating the following deadline.
		 */
		now = k_uptime_ticks();
		if (now >= next_release_tick_ + period_ticks_) {
			const uint64_t skipped =
				static_cast<uint64_t>(
					(now - next_release_tick_) / period_ticks_);
			next_release_tick_ +=
				static_cast<int64_t>(skipped) * period_ticks_;
			missed += skipped;
		}

		next_release_tick_ += period_ticks_;
		AddMissedReleases(missed);
		return missed > std::numeric_limits<uint32_t>::max() ?
			std::numeric_limits<uint32_t>::max() :
			static_cast<uint32_t>(missed);
	}

	/**
	 * @brief 读取累计错过的周期释放次数。
	 * @return 自创建或复位以来累计错过的释放次数。
	 */
	uint32_t total_missed_releases() const
	{
		return total_missed_releases_;
	}

private:
	/**
	 * @brief 将非零毫秒周期转换为内核时钟节拍。
	 * @param milliseconds 待转换的时间长度，单位为毫秒。
	 * @return 至少为 1 的内核节拍数。
	 */
	static int64_t TicksFromMs(uint32_t milliseconds)
	{
		const int64_t ticks = static_cast<int64_t>(
			k_ms_to_ticks_ceil64(milliseconds));
		return ticks > 0 ? ticks : 1;
	}

	/**
	 * @brief 将毫秒时长转换为内核节拍并允许零值。
	 * @param milliseconds 待转换的时间长度，单位为毫秒。
	 * @return 对应的内核节拍数；输入为零时返回零。
	 */
	static int64_t TicksFromMsAllowZero(uint32_t milliseconds)
	{
		return static_cast<int64_t>(
			k_ms_to_ticks_ceil64(milliseconds));
	}

	/**
	 * @brief 以饱和方式累加错过的释放次数。
	 * @param missed 本次检测到的错过释放次数。
	 */
	void AddMissedReleases(uint64_t missed)
	{
		const uint32_t maximum =
			std::numeric_limits<uint32_t>::max();
		if (missed >= maximum - total_missed_releases_) {
			total_missed_releases_ = maximum;
		} else {
			total_missed_releases_ += static_cast<uint32_t>(missed);
		}
	}

	int64_t period_ticks_;
	int64_t initial_phase_ticks_;
	int64_t next_release_tick_;
	uint32_t total_missed_releases_ = 0U;
};

}  // namespace wbr_control::scheduling

#endif  // WBR_CONTROL_SCHEDULING_PERIODIC_SCHEDULE_H_
```

## src/tf_tree.h
```c
/* SPDX-License-Identifier: Apache-2.0 */

#pragma once

#include <Eigen/Core>
#include <sophus/so3.hpp>

namespace wbr_control {

/**
 * @brief 机器人两套 IMU 使用的静态旋转森林。
 * @details 当前拓扑由两棵互不连通的树组成：
 *          `chassis_imu -> chassis` 与
 *          `gimbal_imu -> gimbal -> pc_link`。统一采用
 *          `R_target_from_source` 语义。所有矩阵均为固定尺寸，不进行动态
 *          内存分配、锁等待或运行时图搜索。
 */
class TfTree final {
public:
	/** 静态 TF 中的坐标系节点。 */
	enum class Frame {
		kChassisImu,
		kChassis,
		kGimbalImu,
		kGimbal,
		kPcLink,
	};

	using Rotation = Sophus::SO3f;
	using Vector3 = Eigen::Vector3f;
	using Matrix3 = Eigen::Matrix3f;

	/** 构造尚未配置任何 IMU 分支的 TF。 */
	TfTree() = default;

	/**
	 * @brief 配置底盘 IMU 到底盘坐标系的静态旋转。
	 * @param chassis_from_chassis_imu `R_chassis_from_chassis_imu`。
	 * @note 仅允许在线程启动前配置。
	 */
	void ConfigureChassisBranch(const Rotation &chassis_from_chassis_imu)
	{
		chassis_from_chassis_imu_ = chassis_from_chassis_imu;
		chassis_branch_configured_ = true;
	}

	/**
	 * @brief 预留配置云台 IMU、云台和 pc_link 坐标系三节点分支。
	 * @param gimbal_from_gimbal_imu `R_gimbal_from_gimbal_imu`。
	 * @param pc_link_from_gimbal `R_pc_link_from_gimbal`。
	 * @note 当前尚未接入云台 IMU，不应由底盘 AHRS 调用。
	 */
	void ConfigureGimbalBranch(const Rotation &gimbal_from_gimbal_imu,
				   const Rotation &pc_link_from_gimbal)
	{
		gimbal_from_gimbal_imu_ = gimbal_from_gimbal_imu;
		pc_link_from_gimbal_ = pc_link_from_gimbal;
		gimbal_branch_configured_ = true;
	}

	/**
	 * @brief 将三维向量从 source 转换到 target。
	 * @param target 目标坐标系。
	 * @param source 源坐标系。
	 * @param source_vector 源坐标系中表达的向量。
	 * @param target_vector 接收目标坐标系中表达的向量。
	 * @return 两节点位于同一条已配置分支时返回 true；跨分支或分支未配置时
	 *         返回 false，且不修改 target_vector。
	 */
	bool TransformVector(Frame target, Frame source,
			     const Vector3 &source_vector, Vector3 &target_vector) const
	{
		Matrix3 target_from_source;
		if (!RotationMatrixBetween(target, source, target_from_source)) {
			return false;
		}
		target_vector = target_from_source * source_vector;
		return true;
	}

	/**
	 * @brief 将完整姿态从 source 坐标约定重表达到 target 坐标约定。
	 * @param target 输出姿态采用的坐标系约定。
	 * @param source 输入姿态采用的坐标系约定。
	 * @param source_attitude 在 source 坐标约定下表达的姿态矩阵。
	 * @param target_attitude 接收目标坐标约定下的姿态矩阵。
	 * @return 转换路径可用时返回 true，否则返回 false 且不修改输出。
	 * @details 使用 `A * source_attitude * A.transpose()`，其中
	 *          `A = R_target_from_source`。单位姿态转换后仍为单位姿态，不会
	 *          引入固定安装角对应的虚假 yaw。
	 */
	bool TransformAttitude(Frame target, Frame source,
			       const Matrix3 &source_attitude, Matrix3 &target_attitude) const
	{
		Matrix3 target_from_source;
		if (!RotationMatrixBetween(target, source, target_from_source)) {
			return false;
		}
		target_attitude =
			target_from_source * source_attitude * target_from_source.transpose();
		return true;
	}

private:
	/** 查询两节点之间的旋转；不允许跨越两棵互不连通的树。 */
	bool RotationMatrixBetween(Frame target, Frame source,
				   Matrix3 &target_from_source) const
	{
		if (target == source) {
			target_from_source = Matrix3::Identity();
			return true;
		}

		if (chassis_branch_configured_) {
			if (target == Frame::kChassis && source == Frame::kChassisImu) {
				target_from_source = chassis_from_chassis_imu_.matrix();
				return true;
			}
			if (target == Frame::kChassisImu && source == Frame::kChassis) {
				target_from_source = chassis_from_chassis_imu_.matrix().transpose();
				return true;
			}
		}

		if (gimbal_branch_configured_) {
			if (target == Frame::kGimbal && source == Frame::kGimbalImu) {
				target_from_source = gimbal_from_gimbal_imu_.matrix();
				return true;
			}
			if (target == Frame::kGimbalImu && source == Frame::kGimbal) {
				target_from_source = gimbal_from_gimbal_imu_.matrix().transpose();
				return true;
			}
			if (target == Frame::kPcLink && source == Frame::kGimbal) {
				target_from_source = pc_link_from_gimbal_.matrix();
				return true;
			}
			if (target == Frame::kGimbal && source == Frame::kPcLink) {
				target_from_source = pc_link_from_gimbal_.matrix().transpose();
				return true;
			}
			if (target == Frame::kPcLink && source == Frame::kGimbalImu) {
				target_from_source = pc_link_from_gimbal_.matrix() *
						     gimbal_from_gimbal_imu_.matrix();
				return true;
			}
			if (target == Frame::kGimbalImu && source == Frame::kPcLink) {
				target_from_source = gimbal_from_gimbal_imu_.matrix().transpose() *
						     pc_link_from_gimbal_.matrix().transpose();
				return true;
			}
		}

		return false;
	}

	Rotation chassis_from_chassis_imu_;
	Rotation gimbal_from_gimbal_imu_;
	Rotation pc_link_from_gimbal_;
	bool chassis_branch_configured_ = false;
	bool gimbal_branch_configured_ = false;
};

/**
 * @brief 全机唯一的静态 TF 实例。
 * @note 各 IMU 模块必须在其周期线程启动前配置对应分支；运行期间只读。
 */
inline TfTree robot_tf_tree;

}  // namespace wbr_control
```
