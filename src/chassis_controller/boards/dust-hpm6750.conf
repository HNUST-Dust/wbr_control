## src/chassis_controller/boards/dust-hpm6750.conf
```kconfig
# SPDX-License-Identifier: Apache-2.0

CONFIG_HPM67_DOUBLE_PRECISION_FPU=y
CONFIG_FPU=y
CONFIG_FPU_SHARING=y
```

## test/onboard_imu_filter_test/testcase.yaml
```yaml
tests:
  wbr_control.unit.onboard_imu_filter:
    integration_platforms:
      - qemu_riscv32
    platform_allow:
      - qemu_riscv32
    tags:
      - unit
      - ahrs
```

## test/unit/littlefs_service/testcase.yaml
```yaml
tests:
  wbr_control.unit.littlefs_service:
    integration_platforms:
      - qemu_riscv32
    platform_allow:
      - qemu_riscv32
    tags:
      - unit
      - fff
      - storage
```

## test/unit/protocols/testcase.yaml
```yaml
tests:
  wbr_control.unit.protocols:
    integration_platforms:
      - qemu_riscv32
    platform_allow:
      - qemu_riscv32
    tags:
      - unit
      - protocols
```
